## config/west.yml
```yaml
manifest:
  remotes:
    - name: zmkfirmware
      url-base: https://github.com/zmkfirmware
    - name: urob
      url-base: https://github.com/urob
  projects:
    - name: zmk
      remote: urob
      revision: b74cd39ab59e3f22016502e3515f25d7ca396901
      import: app/west.yml
  self:
    path: config
```
